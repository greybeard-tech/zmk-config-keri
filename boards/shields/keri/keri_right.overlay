
/ {
    chosen {
        zmk,kscan = &kscan1;
        zmk,keyboard = &keymap0;
    };

    kscan1: kscan {
        compatible = "zmk,kscan-gpio-matrix";
        label = "KSCAN_RIGHT";
        debounce-press-ms = <5>;
        debounce-release-ms = <5>;

        diode-direction = "col2row"; // TODO: set to actual

        row-gpios = <
            &pro_micro 6  GPIO_ACTIVE_LOW  /* R0 */
            &pro_micro 5  GPIO_ACTIVE_LOW  /* R1 */
            &pro_micro 4  GPIO_ACTIVE_LOW  /* R2 */
            &pro_micro 3  GPIO_ACTIVE_LOW  /* R3 (2-key row) */
            &pro_micro 2  GPIO_ACTIVE_LOW  /* R4 (thumb row) */
        >;

        col-gpios = <
            &pro_micro 7  GPIO_ACTIVE_LOW  /* C0 */
            &pro_micro 8  GPIO_ACTIVE_LOW  /* C1 */
            &pro_micro 9  GPIO_ACTIVE_LOW  /* C2 */
            &pro_micro 10 GPIO_ACTIVE_LOW  /* C3 */
            &pro_micro 16 GPIO_ACTIVE_LOW  /* C4 */
            &pro_micro 14 GPIO_ACTIVE_LOW  /* C5 */
        >;
    };
};

/ {
    keymap0: keymap {
        compatible = "zmk,keymap";
    };
};
