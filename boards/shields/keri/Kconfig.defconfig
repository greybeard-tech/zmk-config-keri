## boards/shields/keri/Kconfig.defconfig
```kconfig
if SHIELD_KERI_LEFT

# Name must be less than 16 characters long!
config ZMK_KEYBOARD_NAME
    default "keri"

config ZMK_SPLIT_ROLE_CENTRAL
    default y

endif

if SHIELD_KERI_LEFT || SHIELD_KERI_RIGHT

config ZMK_SPLIT
    default y

endif
```

## boards/shields/keri/Kconfig.shield
```kconfig
menuconfig SHIELD_KERI
    bool "Keri (both halves)"
    depends on ZMK_KEYBOARD

config SHIELD_KERI_LEFT
    bool "Keri (left)"
    select ZMK_SPLIT

config SHIELD_KERI_RIGHT
    bool "Keri (right)"
    select ZMK_SPLIT
```
